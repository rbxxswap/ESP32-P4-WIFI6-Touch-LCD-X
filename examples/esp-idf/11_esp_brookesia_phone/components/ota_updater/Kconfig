## examples/esp-idf/11_esp_brookesia_phone/components/ota_updater/Kconfig
```kconfig
menu "OTA Updater"

    config OTA_GH_OWNER
        string "GitHub repository owner"
        default "rbxxswap"

    config OTA_GH_REPO
        string "GitHub repository name"
        default "ESP32-P4-WIFI6-Touch-LCD-X"

    config OTA_ASSET_NAME
        string "Release asset filename to download"
        default "11_esp_brookesia_phone.bin"
        help
            Name of the firmware .bin attached to the GitHub Release.

endmenu
```

## examples/esp-idf/11_esp_brookesia_phone/components/wifi_helper/Kconfig
```kconfig
menu "WiFi Helper"

    config WIFI_HELPER_DEFAULT_SSID
        string "Default SSID (fallback if NVS empty)"
        default ""
        help
            Hardcoded SSID for first boot before settings-app has written NVS.
            Leave empty to disable fallback (NVS-only).
            DO NOT commit secrets - put them in sdkconfig.local (gitignored).

    config WIFI_HELPER_DEFAULT_PASS
        string "Default password (fallback if NVS empty)"
        default ""

    config WIFI_HELPER_MAX_RETRY
        int "Connect retry count"
        default 8
        range 1 50

    config WIFI_HELPER_CONNECT_TIMEOUT_SEC
        int "Connect timeout (seconds)"
        default 30
        range 5 300

endmenu
```
